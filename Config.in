## configs/retrolx-kernel-rk3328_defconfig
```kconfig
# Target definition
BR2_aarch64=y
BR2_cortex_a53=y
BR2_ARM_FPU_NEON_FP_ARMV8=y

# Toolchain definition
BR2_TOOLCHAIN=y
BR2_TOOLCHAIN_USES_GLIBC=y
BR2_TOOLCHAIN_EXTERNAL=y
BR2_TOOLCHAIN_EXTERNAL_BOOTLIN=y
BR2_TOOLCHAIN_EXTERNAL_DOWNLOAD=y
BR2_TOOLCHAIN_EXTERNAL_GLIBC=y
BR2_PACKAGE_HAS_TOOLCHAIN_EXTERNAL=y
BR2_PACKAGE_PROVIDES_TOOLCHAIN_EXTERNAL="toolchain-external-bootlin"
BR2_TOOLCHAIN_EXTERNAL_BOOTLIN_ARCH_SUPPORTS=y
# BR2_TOOLCHAIN_EXTERNAL_BOOTLIN_AARCH64_GLIBC_BLEEDING_EDGE is not set
BR2_TOOLCHAIN_EXTERNAL_BOOTLIN_AARCH64_GLIBC_STABLE=y
BR2_PACKAGE_HOST_GDB_ARCH_SUPPORTS=y
BR2_TOOLCHAIN_SUPPORTS_ALWAYS_LOCKFREE_ATOMIC_INTS=y
BR2_TOOLCHAIN_SUPPORTS_VARIADIC_MI_THUNK=y
BR2_TOOLCHAIN_HAS_NATIVE_RPC=y
BR2_TOOLCHAIN_HAS_THREADS=y
BR2_TOOLCHAIN_HAS_THREADS_DEBUG=y
BR2_TOOLCHAIN_HAS_THREADS_NPTL=y
BR2_TOOLCHAIN_HAS_SSP=y
BR2_TOOLCHAIN_HAS_SSP_STRONG=y
BR2_TOOLCHAIN_HAS_UCONTEXT=y
BR2_TOOLCHAIN_SUPPORTS_PIE=y
BR2_TOOLCHAIN_GLIBC_GCONV_LIBS_LIST=""
BR2_TOOLCHAIN_EXTRA_LIBS=""
BR2_TOOLCHAIN_HAS_FULL_GETTEXT=y
BR2_TOOLCHAIN_HAS_LIBATOMIC=y
BR2_TOOLCHAIN_HAS_ATOMIC=y
BR2_TOOLCHAIN_BUILDROOT_GLIBC=y
BR2_TOOLCHAIN_GLIBC_GCONV_LIBS_COPY=y
BR2_TOOLCHAIN_BUILDROOT_CXX=y

BR2_OPTIMIZE_3=y
BR2_SHARED_STATIC_LIBS=y
BR2_USE_WCHAR=y
BR2_USE_MMU=y
BR2_ENABLE_LOCALE=y
BR2_INSTALL_LIBSTDCPP=y
BR2_ENABLE_LOCALE_WHITELIST="C ar ca cy_GB de el es es_MX eu_ES fr hu it ja_JP ko nb_NO nl nn_NO oc_FR.UTF-8 pl pt_PT pt_BR ru_RU uk_UA sv_SE tr zh_CN zh_TW"
BR2_GENERATE_LOCALE="en_US.UTF-8"
BR2_TARGET_OPTIMIZATION="-pipe -fsigned-char -mcpu=cortex-a53 -mtune=cortex-a53"
BR2_TARGET_GENERIC_HOSTNAME="RetroLX"
BR2_TARGET_GENERIC_ISSUE="Back to the Retro"
BR2_TARGET_ROOTFS_TAR_NONE=y
BR2_ROOTFS_DEVICE_CREATION_DYNAMIC_EUDEV=y
BR2_ROOTFS_POST_BUILD_SCRIPT="$(BR2_EXTERNAL_BATOCERA_PATH)/board/batocera/scripts/package-kernel-modules.sh"

# Kernel
BR2_LINUX_KERNEL=y
BR2_LINUX_KERNEL_LATEST_VERSION=y
BR2_KERNEL_HEADERS_5_15=y
BR2_LINUX_KERNEL_USE_CUSTOM_CONFIG=y
BR2_LINUX_KERNEL_CUSTOM_CONFIG_FILE="$(BR2_EXTERNAL_BATOCERA_PATH)/board/batocera/rockchip/rk3328/linux-rk3328-defconfig.config"
BR2_LINUX_KERNEL_DTS_SUPPORT=y
BR2_LINUX_KERNEL_INTREE_DTS_NAME="rockchip/rk3328-a1 rockchip/rk3328-evb rockchip/rk3328-nanopi-r2s rockchip/rk3328-roc-cc rockchip/rk3328-rock64"
BR2_LINUX_KERNEL_NEEDS_HOST_OPENSSL=y
BR2_LINUX_KERNEL_PATCH="$(BR2_EXTERNAL_BATOCERA_PATH)/board/batocera/linux_patches $(BR2_EXTERNAL_BATOCERA_PATH)/board/batocera/rockchip/rk3328/linux_patches"
BR2_LINUX_KERNEL_CONFIG_FRAGMENT_FILES="$(BR2_EXTERNAL_BATOCERA_PATH)/board/batocera/rockchip/rk3328/linux-defconfig-fragment.config"

# Required to build ??
BR2_PACKAGE_UTIL_LINUX_LIBSMARTCOLS=y
BR2_PACKAGE_UTIL_LINUX_SETTERM=y
BR2_PACKAGE_UTIL_LINUX_LIBMOUNT=y

# Build as zstd squashfs
BR2_PACKAGE_HOST_SQUASHFS=y

# spi flash support
BR2_PACKAGE_MTD=y

# Out-of-tree kernel modules
# KO on 5.15 BR2_PACKAGE_RTL8821AU=y
# KO on 5.15 BR2_PACKAGE_RTL8192EU=y
# KO on 5.15 BR2_PACKAGE_RTL8189FS=y

# Enables ccache
BR2_CCACHE=y

# This config fragment disables Buildroot options that are turned on by
# default, in order to arrive at minimal build time.
BR2_INIT_NONE=y
BR2_SYSTEM_BIN_SH_NONE=y
# BR2_PACKAGE_BUSYBOX is not set
# BR2_TARGET_ROOTFS_TAR is not set
BR2_COMPILER_PARANOID_UNSAFE_PATH=y
BR2_PACKAGE_BUSYBOX_SHOW_OTHERS=y
# Package Patches
BR2_GLOBAL_PATCH_DIR="$(BR2_EXTERNAL_RETROLX_PATH)/board/batocera/patches"
```

## configs/retrolx-kernel-rpi4_defconfig
```kconfig
# Target definition
BR2_aarch64=y
BR2_cortex_a72=y
BR2_ARM_FPU_NEON_FP_ARMV8=y

# Toolchain definition
BR2_GCC_VERSION_10_X=y
BR2_GCC_ENABLE_GRAPHITE=y
BR2_GCC_ENABLE_LTO=y
BR2_OPTIMIZE_3=y
BR2_SHARED_STATIC_LIBS=y
BR2_TOOLCHAIN_BUILDROOT_GLIBC=y
BR2_TOOLCHAIN_GLIBC_GCONV_LIBS_COPY=y
BR2_TOOLCHAIN_BUILDROOT_CXX=y
BR2_ENABLE_LOCALE_WHITELIST="C ar ca cy_GB de el es es_MX eu_ES fr hu it ja_JP ko nb_NO nl nn_NO oc_FR.UTF-8 pl pt_PT pt_BR ru_RU uk_UA sv_SE tr zh_CN zh_TW"
BR2_GENERATE_LOCALE="en_US.UTF-8"
BR2_TARGET_OPTIMIZATION="-pipe -fsigned-char"
BR2_TARGET_GENERIC_HOSTNAME="RetroLX"
BR2_TARGET_GENERIC_ISSUE="Back to the Retro"
BR2_TARGET_ROOTFS_TAR_NONE=y
BR2_ROOTFS_DEVICE_CREATION_DYNAMIC_EUDEV=y
BR2_ROOTFS_POST_BUILD_SCRIPT="$(BR2_EXTERNAL_BATOCERA_PATH)/board/batocera/scripts/package-kernel-modules.sh"

# Kernel
BR2_LINUX_KERNEL=y
BR2_LINUX_KERNEL_CUSTOM_TARBALL=y
BR2_LINUX_KERNEL_CUSTOM_TARBALL_LOCATION="$(call github,raspberrypi,linux,f800047be45a5a811b1a550449647879c7d92e20)/f800047be45a5a811b1a550449647879c7d92e20.tar.gz"
BR2_LINUX_KERNEL_DEFCONFIG="bcm2711"
BR2_LINUX_KERNEL_NEEDS_HOST_OPENSSL=y
BR2_LINUX_KERNEL_PATCH="$(BR2_EXTERNAL_BATOCERA_PATH)/board/batocera/raspberrypi/linux_patches"
BR2_LINUX_KERNEL_CONFIG_FRAGMENT_FILES="$(BR2_EXTERNAL_BATOCERA_PATH)/board/batocera/raspberrypi/linux-defconfig-fragment.config"
BR2_LINUX_KERNEL_IMAGE_TARGET_CUSTOM=y
BR2_LINUX_KERNEL_IMAGE_TARGET_NAME="Image"
BR2_LINUX_KERNEL_DTS_SUPPORT=y
BR2_LINUX_KERNEL_INTREE_DTS_NAME="broadcom/bcm2711-rpi-4-b"

# Required to build ??
BR2_PACKAGE_UTIL_LINUX_LIBSMARTCOLS=y
BR2_PACKAGE_UTIL_LINUX_SETTERM=y
BR2_PACKAGE_UTIL_LINUX_LIBMOUNT=y

# Build as zstd squashfs
BR2_PACKAGE_HOST_SQUASHFS=y

# Out-of-tree kernel modules
BR2_PACKAGE_PYTHON_RPI_GPIO=y
BR2_PACKAGE_MK_ARCADE_JOYSTICK_RPI=y
BR2_PACKAGE_RTL8821AU=y
BR2_PACKAGE_RTL8192EU=y
#does not build BR2_PACKAGE_RTL8821CE=y
BR2_PACKAGE_RTL8723DS=y

# Enables ccache
BR2_CCACHE=y

# This config fragment disables Buildroot options that are turned on by
# default, in order to arrive at minimal build time.
BR2_INIT_NONE=y
BR2_SYSTEM_BIN_SH_NONE=y
# BR2_PACKAGE_BUSYBOX is not set
# BR2_TARGET_ROOTFS_TAR is not set
BR2_COMPILER_PARANOID_UNSAFE_PATH=y
BR2_PACKAGE_BUSYBOX_SHOW_OTHERS=y
```

## configs/retrolx-kernel-s912_defconfig
```kconfig
# Target definition
BR2_aarch64=y
BR2_cortex_a53=y
BR2_ARM_FPU_NEON_FP_ARMV8=y

# Toolchain definition
BR2_GCC_VERSION_10_X=y
BR2_GCC_ENABLE_GRAPHITE=y
BR2_GCC_ENABLE_LTO=y
BR2_OPTIMIZE_3=y
BR2_SHARED_STATIC_LIBS=y
BR2_TOOLCHAIN_BUILDROOT_GLIBC=y
BR2_TOOLCHAIN_GLIBC_GCONV_LIBS_COPY=y
BR2_TOOLCHAIN_BUILDROOT_CXX=y
BR2_ENABLE_LOCALE_WHITELIST="C ar ca cy_GB de el es es_MX eu_ES fr hu it ja_JP ko nb_NO nl nn_NO oc_FR.UTF-8 pl pt_PT pt_BR ru_RU uk_UA sv_SE tr zh_CN zh_TW"
BR2_GENERATE_LOCALE="en_US.UTF-8"
BR2_TARGET_OPTIMIZATION="-pipe -fsigned-char -mcpu=cortex-a53 -mtune=cortex-a53"
BR2_TARGET_GENERIC_HOSTNAME="batocera"
BR2_TARGET_GENERIC_ISSUE="PLAY AGAIN"
BR2_TARGET_ROOTFS_TAR_NONE=y
BR2_ROOTFS_DEVICE_CREATION_DYNAMIC_EUDEV=y
BR2_ROOTFS_POST_BUILD_SCRIPT="$(BR2_EXTERNAL_BATOCERA_PATH)/board/batocera/scripts/package-kernel-modules.sh"

# Kernel
BR2_LINUX_KERNEL=y
BR2_LINUX_KERNEL_CUSTOM_VERSION=y
BR2_LINUX_KERNEL_CUSTOM_VERSION_VALUE="5.10.53"
BR2_KERNEL_HEADERS_5_10=y
BR2_LINUX_KERNEL_DTS_SUPPORT=y
BR2_LINUX_KERNEL_INTREE_DTS_NAME="amlogic/meson-gxm-khadas-vim2 amlogic/meson-gxm-nexbox-a1 amlogic/meson-gxm-q200 amlogic/meson-gxm-q201 amlogic/meson-gxm-rbox-pro amlogic/meson-gxm-s912-libretech-pc amlogic/meson-gxm-vega-s96"
BR2_LINUX_KERNEL_NEEDS_HOST_OPENSSL=y
BR2_LINUX_KERNEL_PATCH="$(BR2_EXTERNAL_BATOCERA_PATH)/board/batocera/amlogic/linux_patches"
BR2_LINUX_KERNEL_USE_CUSTOM_CONFIG=y
BR2_LINUX_KERNEL_CUSTOM_CONFIG_FILE="$(BR2_EXTERNAL_BATOCERA_PATH)/board/batocera/amlogic/linux-meson64-current.config"
BR2_LINUX_KERNEL_CONFIG_FRAGMENT_FILES="$(BR2_EXTERNAL_BATOCERA_PATH)/board/batocera/amlogic/linux-meson64-current-fragment.config"

# Required to build ??
BR2_PACKAGE_UTIL_LINUX_LIBSMARTCOLS=y
BR2_PACKAGE_UTIL_LINUX_SETTERM=y
BR2_PACKAGE_UTIL_LINUX_LIBMOUNT=y

# Build as zstd squashfs
BR2_PACKAGE_HOST_SQUASHFS=y

# Out-of-tree kernel modules
BR2_PACKAGE_RTL8821AU=y
BR2_PACKAGE_RTL8192EU=y
BR2_PACKAGE_RTL8821CE=y
BR2_PACKAGE_RTL8723DS=n

# Enables ccache
BR2_CCACHE=y

# This config fragment disables Buildroot options that are turned on by
# default, in order to arrive at minimal build time.
BR2_INIT_NONE=y
BR2_SYSTEM_BIN_SH_NONE=y
# BR2_PACKAGE_BUSYBOX is not set
# BR2_TARGET_ROOTFS_TAR is not set
BR2_COMPILER_PARANOID_UNSAFE_PATH=y
BR2_PACKAGE_BUSYBOX_SHOW_OTHERS=y
```

## configs/retrolx-kernel-sun50i_defconfig
```kconfig
# Target definition
BR2_aarch64=y
BR2_cortex_a53=y
BR2_ARM_FPU_NEON_FP_ARMV8=y

# Toolchain definition
BR2_TOOLCHAIN=y
BR2_TOOLCHAIN_USES_GLIBC=y
BR2_TOOLCHAIN_EXTERNAL=y
BR2_TOOLCHAIN_EXTERNAL_BOOTLIN=y
BR2_TOOLCHAIN_EXTERNAL_DOWNLOAD=y
BR2_TOOLCHAIN_EXTERNAL_GLIBC=y
BR2_PACKAGE_HAS_TOOLCHAIN_EXTERNAL=y
BR2_PACKAGE_PROVIDES_TOOLCHAIN_EXTERNAL="toolchain-external-bootlin"
BR2_TOOLCHAIN_EXTERNAL_BOOTLIN_ARCH_SUPPORTS=y
# BR2_TOOLCHAIN_EXTERNAL_BOOTLIN_AARCH64_GLIBC_BLEEDING_EDGE is not set
BR2_TOOLCHAIN_EXTERNAL_BOOTLIN_AARCH64_GLIBC_STABLE=y
BR2_PACKAGE_HOST_GDB_ARCH_SUPPORTS=y
BR2_TOOLCHAIN_SUPPORTS_ALWAYS_LOCKFREE_ATOMIC_INTS=y
BR2_TOOLCHAIN_SUPPORTS_VARIADIC_MI_THUNK=y
BR2_TOOLCHAIN_HAS_NATIVE_RPC=y
BR2_TOOLCHAIN_HAS_THREADS=y
BR2_TOOLCHAIN_HAS_THREADS_DEBUG=y
BR2_TOOLCHAIN_HAS_THREADS_NPTL=y
BR2_TOOLCHAIN_HAS_SSP=y
BR2_TOOLCHAIN_HAS_SSP_STRONG=y
BR2_TOOLCHAIN_HAS_UCONTEXT=y
BR2_TOOLCHAIN_SUPPORTS_PIE=y
BR2_TOOLCHAIN_GLIBC_GCONV_LIBS_LIST=""
BR2_TOOLCHAIN_EXTRA_LIBS=""
BR2_TOOLCHAIN_HAS_FULL_GETTEXT=y
BR2_TOOLCHAIN_HAS_LIBATOMIC=y
BR2_TOOLCHAIN_HAS_ATOMIC=y
BR2_TOOLCHAIN_BUILDROOT_GLIBC=y
BR2_TOOLCHAIN_GLIBC_GCONV_LIBS_COPY=y
BR2_TOOLCHAIN_BUILDROOT_CXX=y

BR2_OPTIMIZE_3=y
BR2_SHARED_STATIC_LIBS=y
BR2_USE_WCHAR=y
BR2_USE_MMU=y
BR2_ENABLE_LOCALE=y
BR2_INSTALL_LIBSTDCPP=y
BR2_ENABLE_LOCALE_WHITELIST="C ar ca cy_GB de el es es_MX eu_ES fr hu it ja_JP ko nb_NO nl nn_NO oc_FR.UTF-8 pl pt_PT pt_BR ru_RU uk_UA sv_SE tr zh_CN zh_TW"
BR2_GENERATE_LOCALE="en_US.UTF-8"
BR2_TARGET_OPTIMIZATION="-pipe -fsigned-char -mcpu=cortex-a53 -mtune=cortex-a53"
BR2_TARGET_GENERIC_HOSTNAME="RetroLX"
BR2_TARGET_GENERIC_ISSUE="Back to the Retro"
BR2_TARGET_ROOTFS_TAR_NONE=y
BR2_ROOTFS_DEVICE_CREATION_DYNAMIC_EUDEV=y
BR2_ROOTFS_POST_BUILD_SCRIPT="$(BR2_EXTERNAL_RETROLX_PATH)/board/retrolx/scripts/package-kernel-modules.sh"

# Kernel
BR2_LINUX_KERNEL=y
BR2_LINUX_KERNEL_LATEST_VERSION=y
BR2_KERNEL_HEADERS_5_15=y
BR2_LINUX_KERNEL_USE_CUSTOM_CONFIG=y
BR2_LINUX_KERNEL_CUSTOM_CONFIG_FILE="$(BR2_EXTERNAL_RETROLX_PATH)/board/retrolx/allwinner/sun50i/linux-defconfig.config"
BR2_LINUX_KERNEL_DTS_SUPPORT=y
BR2_LINUX_KERNEL_INTREE_DTS_NAME="allwinner/sun50i-h5-bananapi-m2-plus-v1.2 allwinner/sun50i-h5-bananapi-m2-plus allwinner/sun50i-h5-emlid-neutis-n5-devboard allwinner/sun50i-h5-libretech-all-h3-cc allwinner/sun50i-h5-libretech-all-h3-it allwinner/sun50i-h5-libretech-all-h5-cc allwinner/sun50i-h5-nanopi-neo-plus2 allwinner/sun50i-h5-nanopi-neo2 allwinner/sun50i-h5-orangepi-pc2 allwinner/sun50i-h5-orangepi-prime allwinner/sun50i-h5-orangepi-zero-plus allwinner/sun50i-h5-orangepi-zero-plus2 allwinner/sun50i-h6-beelink-gs1 allwinner/sun50i-h6-orangepi-3 allwinner/sun50i-h6-orangepi-lite2 allwinner/sun50i-h6-orangepi-one-plus allwinner/sun50i-h6-pine-h64-model-b allwinner/sun50i-h6-pine-h64 allwinner/sun50i-h6-tanix-tx6 allwinner/sun50i-h616-orangepi-zero2"
BR2_LINUX_KERNEL_NEEDS_HOST_OPENSSL=y
BR2_LINUX_KERNEL_PATCH="$(BR2_EXTERNAL_RETROLX_PATH)/board/retrolx/linux_patches $(BR2_EXTERNAL_RETROLX_PATH)/board/retrolx/allwinner/sun50i/linux_patches"
BR2_LINUX_KERNEL_CONFIG_FRAGMENT_FILES="$(BR2_EXTERNAL_RETROLX_PATH)/board/retrolx/allwinner/sun50i/linux-defconfig-fragment.config"

# Required to build ??
BR2_PACKAGE_UTIL_LINUX_LIBSMARTCOLS=y
BR2_PACKAGE_UTIL_LINUX_SETTERM=y
BR2_PACKAGE_UTIL_LINUX_LIBMOUNT=y

# Build as zstd squashfs
BR2_PACKAGE_HOST_SQUASHFS=y

# spi flash support
BR2_PACKAGE_MTD=y

# Out-of-tree kernel modules
BR2_PACKAGE_RTL8192EU=y
15 BR2_PACKAGE_RTL8189FS=n
# KO on 5.15 BR2_PACKAGE_RTL8821AU=y

# Disable ccache
BR2_CCACHE=n
# Enable common downloads cache across build trees
BR2_DL_DIR="$(BR2_EXTERNAL_RETROLX_PATH)/buildroot-dlcache"

# This config fragment disables Buildroot options that are turned on by
# default, in order to arrive at minimal build time.
BR2_INIT_NONE=y
BR2_SYSTEM_BIN_SH_NONE=y
# BR2_PACKAGE_BUSYBOX is not set
# BR2_TARGET_ROOTFS_TAR is not set
BR2_COMPILER_PARANOID_UNSAFE_PATH=y
BR2_PACKAGE_BUSYBOX_SHOW_OTHERS=y
# Package Patches
BR2_GLOBAL_PATCH_DIR="$(BR2_EXTERNAL_RETROLX_PATH)/board/retrolx/patches"
```

## package/retrolx/controllers/xone/Config.in
```kconfig
config BR2_PACKAGE_XONE
	bool "xone"

	help
	  xone is a Linux kernel driver for Xbox One and Xbox Series X|S accessories. 
	  It serves as a modern replacement for xpad, aiming to be compatible with Microsoft's Game Input Protocol (GIP).
```

## package/retrolx/gpu/retrolx-nvidia-kernel-module/Config.in
```kconfig
config BR2_PACKAGE_RETROLX_NVIDIA_KERNEL_MODULE
	bool "retrolx-nvidia-kernel-module"
	depends on BR2_LINUX_KERNEL
	depends on BR2_x86_64
	select BR2_LINUX_NEEDS_MODULES # not using kernel-module infra
	help
	  Build the nvidia.ko kernel module.

	  If CUDA support (above) is set, and the target is x86_64, then
	  this will also build the nvidia-uvm.ko kernel module, which
	  provides Unified Memory access to the GPU and CPU memories for
	  CUDA programs.
```
