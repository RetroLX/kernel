## Config.in
```kconfig
menu "RetroLX.kernel"

menu "System"

  menu "Gpu"
    source "$BR2_EXTERNAL_RETROLX_PATH/package/retrolx/gpu/mali-midgard-module/Config.in"
    source "$BR2_EXTERNAL_RETROLX_PATH/package/retrolx/gpu/retrolx-nvidia-kernel-module/Config.in"
  endmenu

  menu "Network"
    source "$BR2_EXTERNAL_RETROLX_PATH/package/retrolx/network/rtl8192eu/Config.in"
    source "$BR2_EXTERNAL_RETROLX_PATH/package/retrolx/network/rtl8188fu/Config.in"
    source "$BR2_EXTERNAL_RETROLX_PATH/package/retrolx/network/esp8089/Config.in"
  endmenu

  menu "Device trees"
  endmenu
endmenu

menu "Controllers"
  source "$BR2_EXTERNAL_RETROLX_PATH/package/retrolx/controllers/db9_gpio_rpi/Config.in"
  source "$BR2_EXTERNAL_RETROLX_PATH/package/retrolx/controllers/gamecon_gpio_rpi/Config.in"
  source "$BR2_EXTERNAL_RETROLX_PATH/package/retrolx/controllers/mk_arcade_joystick_rpi/Config.in"
endmenu

endmenu
```

## configs/batocera-kernel-rpi2_defconfig
```kconfig
# Target definition
BR2_arm=y
BR2_cortex_a7=y
BR2_ARM_FPU_NEON_VFPV4=y

# Toolchain definition
BR2_GCC_VERSION_10_X=y
BR2_GCC_ENABLE_GRAPHITE=y
BR2_GCC_ENABLE_LTO=y
BR2_OPTIMIZE_3=y
BR2_SHARED_STATIC_LIBS=y
BR2_TOOLCHAIN_BUILDROOT_GLIBC=y
BR2_TOOLCHAIN_GLIBC_GCONV_LIBS_COPY=y
BR2_TOOLCHAIN_BUILDROOT_CXX=y
BR2_TARGET_OPTIMIZATION="-pipe -fsigned-char"
BR2_TARGET_GENERIC_HOSTNAME="batocera"
BR2_TARGET_GENERIC_ISSUE="PLAY AGAIN"
BR2_INIT_SYSV=y
BR2_ROOTFS_DEVICE_CREATION_DYNAMIC_EUDEV=y
BR2_TARGET_GENERIC_ROOT_PASSWD="linux"
#BR2_TARGET_GENERIC_GETTY_PORT="tty1"
BR2_TARGET_GENERIC_GETTY_BAUDRATE_115200=y
# BR2_TARGET_GENERIC_REMOUNT_ROOTFS_RW is not set
BR2_ENABLE_LOCALE_WHITELIST="C ar ca cy_GB de el es es_MX eu_ES fr hu it ja_JP ko nb_NO nl nn_NO oc_FR.UTF-8 pl pt_PT pt_BR ru_RU uk_UA sv_SE tr zh_CN zh_TW"
BR2_GENERATE_LOCALE="en_US.UTF-8"
BR2_TARGET_TZ_INFO=y
BR2_TARGET_LOCALTIME="Europe/Paris"
BR2_GLOBAL_PATCH_DIR="$(BR2_EXTERNAL_BATOCERA_PATH)/board/batocera/patches $(BR2_EXTERNAL_BATOCERA_PATH)/board/batocera/raspberrypi/rpi/patches"
BR2_ROOTFS_OVERLAY="$(BR2_EXTERNAL_BATOCERA_PATH)/board/batocera/fsoverlay $(BR2_EXTERNAL_BATOCERA_PATH)/board/batocera/raspberrypi/rpi/fsoverlay"
BR2_ROOTFS_POST_BUILD_SCRIPT="$(BR2_EXTERNAL_BATOCERA_PATH)/board/batocera/scripts/post-build-script.sh"
BR2_ROOTFS_POST_IMAGE_SCRIPT="$(BR2_EXTERNAL_BATOCERA_PATH)/board/batocera/scripts/post-image-script.sh"

# Linux headers same as kernel, a 5.10 series
BR2_PACKAGE_HOST_LINUX_HEADERS_CUSTOM_5_10=y

# Kernel
BR2_LINUX_KERNEL=y
BR2_LINUX_KERNEL_CUSTOM_TARBALL=y
BR2_LINUX_KERNEL_CUSTOM_TARBALL_LOCATION="$(call github,raspberrypi,linux,raspberrypi-kernel_1.20210527-1)/raspberrypi-kernel_1.20210527-1.tar.gz"
BR2_LINUX_KERNEL_DEFCONFIG="bcm2709"
BR2_LINUX_KERNEL_NEEDS_HOST_OPENSSL=y
BR2_LINUX_KERNEL_PATCH="$(BR2_EXTERNAL_BATOCERA_PATH)/board/batocera/raspberrypi/rpi/linux_patches"
BR2_LINUX_KERNEL_CONFIG_FRAGMENT_FILES="$(BR2_EXTERNAL_BATOCERA_PATH)/board/batocera/raspberrypi/linux-defconfig-fragment.config"

# Build the DTB from the kernel sources
BR2_LINUX_KERNEL_DTS_SUPPORT=y
BR2_LINUX_KERNEL_INTREE_DTS_NAME="bcm2709-rpi-2-b"

# Python and LUA choices
BR2_PACKAGE_PYTHON3_PY_PYC=y
BR2_PACKAGE_PYTHON_HASHLIB=y
BR2_PACKAGE_LUA_5_1=y

# GPIO Kernel Module
BR2_PACKAGE_MK_ARCADE_JOYSTICK_RPI=y

# Batocera system
BR2_PACKAGE_PYTHON_RPI_GPIO=y

# Batocera dev
#BR2_PACKAGE_BATOCERA_DEV=y
#BR2_PACKAGE_BATOCERA_DEBUG=y
#BR2_PACKAGE_BATOCERA_CORES_EXPERIMENTAL=y

# Enables ccache
BR2_CCACHE=y
```

## configs/retrolx-kernel-aw32_defconfig
```kconfig
# Target definition
BR2_arm=y
BR2_cortex_a7=y
BR2_ARM_FPU_NEON_VFPV4=y

# Toolchain definition
BR2_TOOLCHAIN=y
BR2_TOOLCHAIN_USES_GLIBC=y
BR2_TOOLCHAIN_EXTERNAL=y
BR2_TOOLCHAIN_EXTERNAL_BOOTLIN=y
BR2_TOOLCHAIN_EXTERNAL_DOWNLOAD=y
BR2_TOOLCHAIN_EXTERNAL_GLIBC=y
BR2_PACKAGE_HAS_TOOLCHAIN_EXTERNAL=y
BR2_PACKAGE_PROVIDES_TOOLCHAIN_EXTERNAL="toolchain-external-bootlin"
BR2_TOOLCHAIN_EXTERNAL_BOOTLIN_ARCH_SUPPORTS=y
# BR2_TOOLCHAIN_EXTERNAL_BOOTLIN_ARMV7_EABIHF_GLIBC_BLEEDING_EDGE is not set
BR2_TOOLCHAIN_EXTERNAL_BOOTLIN_ARMV7_EABIHF_GLIBC_STABLE=y
BR2_PACKAGE_HOST_GDB_ARCH_SUPPORTS=y
BR2_TOOLCHAIN_SUPPORTS_ALWAYS_LOCKFREE_ATOMIC_INTS=y
BR2_TOOLCHAIN_SUPPORTS_VARIADIC_MI_THUNK=y
BR2_TOOLCHAIN_HAS_NATIVE_RPC=y
BR2_TOOLCHAIN_HAS_THREADS=y
BR2_TOOLCHAIN_HAS_THREADS_DEBUG=y
BR2_TOOLCHAIN_HAS_THREADS_NPTL=y
BR2_TOOLCHAIN_HAS_SSP=y
BR2_TOOLCHAIN_HAS_SSP_STRONG=y
BR2_TOOLCHAIN_HAS_UCONTEXT=y
BR2_TOOLCHAIN_SUPPORTS_PIE=y
BR2_TOOLCHAIN_GLIBC_GCONV_LIBS_LIST=""
BR2_TOOLCHAIN_EXTRA_LIBS=""
BR2_TOOLCHAIN_HAS_FULL_GETTEXT=y
BR2_TOOLCHAIN_HAS_LIBATOMIC=y
BR2_TOOLCHAIN_HAS_ATOMIC=y
BR2_TOOLCHAIN_BUILDROOT_GLIBC=y
BR2_TOOLCHAIN_GLIBC_GCONV_LIBS_COPY=y
BR2_TOOLCHAIN_BUILDROOT_CXX=y

BR2_OPTIMIZE_3=y
BR2_SHARED_STATIC_LIBS=y
BR2_USE_WCHAR=y
BR2_USE_MMU=y
BR2_ENABLE_LOCALE=y
BR2_INSTALL_LIBSTDCPP=y
BR2_ENABLE_LOCALE_WHITELIST="C ar ca cy_GB de el es es_MX eu_ES fr hu it ja_JP ko nb_NO nl nn_NO oc_FR.UTF-8 pl pt_PT pt_BR ru_RU uk_UA sv_SE tr zh_CN zh_TW"
BR2_GENERATE_LOCALE="en_US.UTF-8"
BR2_TARGET_OPTIMIZATION="-pipe -fsigned-char"
BR2_TARGET_GENERIC_HOSTNAME="RetroLX"
BR2_TARGET_GENERIC_ISSUE="Back to the Retro"
BR2_TARGET_ROOTFS_TAR_NONE=y
BR2_ROOTFS_DEVICE_CREATION_DYNAMIC_EUDEV=y
BR2_ROOTFS_POST_BUILD_SCRIPT="$(BR2_EXTERNAL_BATOCERA_PATH)/board/batocera/scripts/package-kernel-modules.sh"

# Kernel
BR2_LINUX_KERNEL=y
BR2_LINUX_KERNEL_CUSTOM_VERSION=y
BR2_LINUX_KERNEL_CUSTOM_VERSION_VALUE="5.10.75"
BR2_KERNEL_HEADERS_5_10=y
BR2_LINUX_KERNEL_DTS_SUPPORT=y
BR2_LINUX_KERNEL_INTREE_DTS_NAME="sun7i-a20-bananapi-m1-plus sun7i-a20-bananapi sun7i-a20-bananapro sun7i-a20-cubieboard2 sun7i-a20-cubietruck sun7i-a20-hummingbird sun7i-a20-i12-tvbox sun7i-a20-icnova-swac sun7i-a20-itead-ibox sun7i-a20-lamobo-r1 sun7i-a20-linutronix-testbox-v2 sun7i-a20-m3 sun7i-a20-mk808c sun7i-a20-olimex-som-evb-emmc sun7i-a20-olimex-som-evb sun7i-a20-olimex-som204-evb-emmc sun7i-a20-olimex-som204-evb sun7i-a20-olinuxino-lime-emmc sun7i-a20-olinuxino-lime sun7i-a20-olinuxino-lime2-emmc sun7i-a20-olinuxino-lime2 sun7i-a20-olinuxino-micro-emmc sun7i-a20-olinuxino-micro sun7i-a20-orangepi-mini sun7i-a20-orangepi sun7i-a20-pcduino3-nano sun7i-a20-pcduino3 sun7i-a20-wexler-tab7200 sun7i-a20-wits-pro-a20-dkt sun8i-h3-bananapi-m2-plus-v1.2 sun8i-h3-bananapi-m2-plus sun8i-h3-beelink-x2 sun8i-h3-emlid-neutis-n5h3-devboard sun8i-h3-mapleboard-mp130 sun8i-h3-nanopi-m1-plus sun8i-h3-nanopi-m1 sun8i-h3-libretech-all-h3-cc sun8i-h3-orangepi-pc sun8i-h3-orangepi-pc-plus sun8i-h3-orangepi-2 sun8i-h3-orangepi-lite sun8i-h3-orangepi-one sun8i-h3-orangepi-plus sun8i-h3-orangepi-plus2e sun8i-h3-orangepi-zero-plus2"
BR2_LINUX_KERNEL_NEEDS_HOST_OPENSSL=y
BR2_LINUX_KERNEL_USE_CUSTOM_CONFIG=y
BR2_LINUX_KERNEL_CUSTOM_CONFIG_FILE="$(BR2_EXTERNAL_BATOCERA_PATH)/board/batocera/allwinner/aw32/linux-defconfig.config"
BR2_LINUX_KERNEL_PATCH="$(BR2_EXTERNAL_BATOCERA_PATH)/board/batocera/allwinner/aw32/linux_patches"
BR2_LINUX_KERNEL_CONFIG_FRAGMENT_FILES="$(BR2_EXTERNAL_BATOCERA_PATH)/board/batocera/allwinner/aw32/linux-defconfig-fragment.config"

# Required to build ??
BR2_PACKAGE_UTIL_LINUX_LIBSMARTCOLS=y
BR2_PACKAGE_UTIL_LINUX_SETTERM=y
BR2_PACKAGE_UTIL_LINUX_LIBMOUNT=y

# Build as zstd squashfs
BR2_PACKAGE_HOST_SQUASHFS=y

# spi flash support
BR2_PACKAGE_MTD=y

# Out-of-tree kernel modules
BR2_PACKAGE_RTL8821AU=y
BR2_PACKAGE_RTL8192EU=y
# does not build BR2_PACKAGE_RTL8821CE=n
BR2_PACKAGE_RTL8723DS=y
BR2_PACKAGE_RTL8189FS=y

# Enables ccache
BR2_CCACHE=y

# This config fragment disables Buildroot options that are turned on by
# default, in order to arrive at minimal build time.
BR2_INIT_NONE=y
BR2_SYSTEM_BIN_SH_NONE=y
# BR2_PACKAGE_BUSYBOX is not set
# BR2_TARGET_ROOTFS_TAR is not set
BR2_COMPILER_PARANOID_UNSAFE_PATH=y
BR2_PACKAGE_BUSYBOX_SHOW_OTHERS=y
```

## configs/retrolx-kernel-h3_defconfig
```kconfig
# Target definition
BR2_arm=y
BR2_cortex_a7=y
BR2_ARM_FPU_NEON_VFPV4=y

# Toolchain definition
BR2_GCC_VERSION_11_X=y
BR2_GCC_ENABLE_GRAPHITE=y
BR2_GCC_ENABLE_LTO=y
BR2_OPTIMIZE_3=y
BR2_SHARED_STATIC_LIBS=y
BR2_TOOLCHAIN_BUILDROOT_GLIBC=y
BR2_TOOLCHAIN_GLIBC_GCONV_LIBS_COPY=y
BR2_TOOLCHAIN_BUILDROOT_CXX=y
BR2_ENABLE_LOCALE_WHITELIST="C ar ca cy_GB de el es es_MX eu_ES fr hu it ja_JP ko nb_NO nl nn_NO oc_FR.UTF-8 pl pt_PT pt_BR ru_RU uk_UA sv_SE tr zh_CN zh_TW"
BR2_GENERATE_LOCALE="en_US.UTF-8"
BR2_TARGET_OPTIMIZATION="-pipe -fsigned-char"
BR2_TARGET_GENERIC_HOSTNAME="batocera"
BR2_TARGET_GENERIC_ISSUE="PLAY AGAIN"
BR2_TARGET_ROOTFS_TAR_NONE=y
BR2_ROOTFS_DEVICE_CREATION_DYNAMIC_EUDEV=y
BR2_ROOTFS_POST_BUILD_SCRIPT="$(BR2_EXTERNAL_BATOCERA_PATH)/board/batocera/scripts/package-kernel-modules.sh"

# Kernel
BR2_LINUX_KERNEL=y
BR2_LINUX_KERNEL_CUSTOM_VERSION=y
BR2_LINUX_KERNEL_CUSTOM_VERSION_VALUE="5.10.57"
BR2_KERNEL_HEADERS_5_10=y
BR2_LINUX_KERNEL_DTS_SUPPORT=y
BR2_LINUX_KERNEL_INTREE_DTS_NAME="sun8i-h3-bananapi-m2-plus-v1.2 sun8i-h3-bananapi-m2-plus sun8i-h3-beelink-x2 sun8i-h3-emlid-neutis-n5h3-devboard sun8i-h3-mapleboard-mp130 sun8i-h3-nanopi-m1-plus sun8i-h3-nanopi-m1 sun8i-h3-libretech-all-h3-cc sun8i-h3-orangepi-pc sun8i-h3-orangepi-pc-plus sun8i-h3-orangepi-2 sun8i-h3-orangepi-lite sun8i-h3-orangepi-one sun8i-h3-orangepi-plus sun8i-h3-orangepi-plus2e sun8i-h3-orangepi-zero-plus2"
BR2_LINUX_KERNEL_NEEDS_HOST_OPENSSL=y
BR2_LINUX_KERNEL_USE_CUSTOM_CONFIG=y
BR2_LINUX_KERNEL_CUSTOM_CONFIG_FILE="$(BR2_EXTERNAL_BATOCERA_PATH)/board/batocera/allwinner/h3/linux-defconfig.config"
BR2_LINUX_KERNEL_PATCH="$(BR2_EXTERNAL_BATOCERA_PATH)/board/batocera/allwinner/h3/linux_patches"
BR2_LINUX_KERNEL_CONFIG_FRAGMENT_FILES="$(BR2_EXTERNAL_BATOCERA_PATH)/board/batocera/allwinner/h3/linux-defconfig-fragment.config"

# Required to build ??
BR2_PACKAGE_UTIL_LINUX_LIBSMARTCOLS=y
BR2_PACKAGE_UTIL_LINUX_SETTERM=y
BR2_PACKAGE_UTIL_LINUX_LIBMOUNT=y

# Build as zstd squashfs
BR2_PACKAGE_HOST_SQUASHFS=y

# spi flash support
BR2_PACKAGE_MTD=y

# Out-of-tree kernel modules
BR2_PACKAGE_RTL8821AU=y
BR2_PACKAGE_RTL8192EU=y
# does not build BR2_PACKAGE_RTL8821CE=n
BR2_PACKAGE_RTL8723DS=y
BR2_PACKAGE_RTL8189FS=y

# Enables ccache
BR2_CCACHE=y

# This config fragment disables Buildroot options that are turned on by
# default, in order to arrive at minimal build time.
BR2_INIT_NONE=y
BR2_SYSTEM_BIN_SH_NONE=y
# BR2_PACKAGE_BUSYBOX is not set
# BR2_TARGET_ROOTFS_TAR is not set
BR2_COMPILER_PARANOID_UNSAFE_PATH=y
BR2_PACKAGE_BUSYBOX_SHOW_OTHERS=y
```

## configs/retrolx-kernel-h5_defconfig
```kconfig
# Target definition
BR2_aarch64=y
BR2_cortex_a53=y
BR2_ARM_FPU_NEON_FP_ARMV8=y

# Toolchain definition
BR2_GCC_VERSION_11_X=y
BR2_GCC_ENABLE_GRAPHITE=y
BR2_GCC_ENABLE_LTO=y
BR2_OPTIMIZE_3=y
BR2_SHARED_STATIC_LIBS=y
BR2_TOOLCHAIN_BUILDROOT_GLIBC=y
BR2_TOOLCHAIN_GLIBC_GCONV_LIBS_COPY=y
BR2_TOOLCHAIN_BUILDROOT_CXX=y
BR2_ENABLE_LOCALE_WHITELIST="C ar ca cy_GB de el es es_MX eu_ES fr hu it ja_JP ko nb_NO nl nn_NO oc_FR.UTF-8 pl pt_PT pt_BR ru_RU uk_UA sv_SE tr zh_CN zh_TW"
BR2_GENERATE_LOCALE="en_US.UTF-8"
BR2_TARGET_OPTIMIZATION="-pipe -fsigned-char -mcpu=cortex-a53 -mtune=cortex-a53"
BR2_TARGET_GENERIC_HOSTNAME="batocera"
BR2_TARGET_GENERIC_ISSUE="PLAY AGAIN"
BR2_TARGET_ROOTFS_TAR_NONE=y
BR2_ROOTFS_DEVICE_CREATION_DYNAMIC_EUDEV=y
BR2_ROOTFS_POST_BUILD_SCRIPT="$(BR2_EXTERNAL_BATOCERA_PATH)/board/batocera/scripts/package-kernel-modules.sh"

# Kernel
BR2_LINUX_KERNEL=y
BR2_LINUX_KERNEL_CUSTOM_VERSION=y
BR2_LINUX_KERNEL_CUSTOM_VERSION_VALUE="5.10.56"
BR2_KERNEL_HEADERS_5_10=y
BR2_LINUX_KERNEL_DTS_SUPPORT=y

BR2_LINUX_KERNEL_INTREE_DTS_NAME="allwinner/sun50i-h5-bananapi-m2-plus-v1.2 allwinner/sun50i-h5-bananapi-m2-plus allwinner/sun50i-h5-emlid-neutis-n5-devboard allwinner/sun50i-h5-libretech-all-h3-cc allwinner/sun50i-h5-libretech-all-h3-it allwinner/sun50i-h5-libretech-all-h5-cc allwinner/sun50i-h5-nanopi-neo-plus2 allwinner/sun50i-h5-nanopi-neo2 allwinner/sun50i-h5-orangepi-pc2 allwinner/sun50i-h5-orangepi-prime allwinner/sun50i-h5-orangepi-zero-plus allwinner/sun50i-h5-orangepi-zero-plus2"
BR2_LINUX_KERNEL_NEEDS_HOST_OPENSSL=y
BR2_LINUX_KERNEL_USE_CUSTOM_CONFIG=y
BR2_LINUX_KERNEL_CUSTOM_CONFIG_FILE="$(BR2_EXTERNAL_BATOCERA_PATH)/board/batocera/allwinner/h5/linux-defconfig.config"
BR2_LINUX_KERNEL_PATCH="$(BR2_EXTERNAL_BATOCERA_PATH)/board/batocera/allwinner/h5/linux_patches"
BR2_LINUX_KERNEL_CONFIG_FRAGMENT_FILES="$(BR2_EXTERNAL_BATOCERA_PATH)/board/batocera/allwinner/h5/linux-defconfig-fragment.config"

# Required to build ??
BR2_PACKAGE_UTIL_LINUX_LIBSMARTCOLS=y
BR2_PACKAGE_UTIL_LINUX_SETTERM=y
BR2_PACKAGE_UTIL_LINUX_LIBMOUNT=y

# Build as zstd squashfs
BR2_PACKAGE_HOST_SQUASHFS=y

# spi flash support
BR2_PACKAGE_MTD=y

# Out-of-tree kernel modules
BR2_PACKAGE_RTL8821AU=y
BR2_PACKAGE_RTL8192EU=y
#does not build BR2_PACKAGE_RTL8821CE=y
BR2_PACKAGE_RTL8723DS=y
BR2_PACKAGE_RTL8189FS=n

# Enables ccache
BR2_CCACHE=y

# This config fragment disables Buildroot options that are turned on by
# default, in order to arrive at minimal build time.
BR2_INIT_NONE=y
BR2_SYSTEM_BIN_SH_NONE=y
# BR2_PACKAGE_BUSYBOX is not set
# BR2_TARGET_ROOTFS_TAR is not set
BR2_COMPILER_PARANOID_UNSAFE_PATH=y
BR2_PACKAGE_BUSYBOX_SHOW_OTHERS=y
```

## configs/retrolx-kernel-ps4_defconfig
```kconfig
# Target definition
BR2_x86_64=y

# Toolchain definition
BR2_GCC_VERSION_11_X=y
BR2_GCC_ENABLE_GRAPHITE=y
BR2_GCC_ENABLE_LTO=y
BR2_OPTIMIZE_3=y
BR2_SHARED_STATIC_LIBS=y
BR2_TOOLCHAIN_BUILDROOT_GLIBC=y
BR2_TOOLCHAIN_GLIBC_GCONV_LIBS_COPY=y
BR2_TOOLCHAIN_BUILDROOT_CXX=y
BR2_ENABLE_LOCALE_WHITELIST="C ar ca cy_GB de el es es_MX eu_ES fr hu it ja_JP ko nb_NO nl nn_NO oc_FR.UTF-8 pl pt_PT pt_BR ru_RU uk_UA sv_SE tr zh_CN zh_TW"
BR2_GENERATE_LOCALE="en_US.UTF-8"
BR2_TARGET_OPTIMIZATION="-pipe -fsigned-char"
BR2_TARGET_GENERIC_HOSTNAME="RetroLX"
BR2_TARGET_GENERIC_ISSUE="Back to the Retro"
BR2_TARGET_ROOTFS_TAR_NONE=y
BR2_ROOTFS_DEVICE_CREATION_DYNAMIC_EUDEV=y
BR2_ROOTFS_POST_BUILD_SCRIPT="$(BR2_EXTERNAL_RETROLX_PATH)/board/retrolx/scripts/package-kernel-modules.sh"

# Kernel
BR2_LINUX_KERNEL=y
BR2_LINUX_KERNEL_CUSTOM_GIT=y
BR2_LINUX_KERNEL_CUSTOM_REPO_URL="https://github.com/codedwrench/ps4-linux"
BR2_LINUX_KERNEL_CUSTOM_REPO_VERSION="266268feaf48c58c50b166051c4bc8954a11282c"
BR2_KERNEL_HEADERS_5_15=y
# No kernel patch for PS4
#BR2_LINUX_KERNEL_PATCH="$(BR2_EXTERNAL_RETROLX_PATH)/board/retrolx/linux_patches $(BR2_EXTERNAL_RETROLX_PATH)/board/retrolx/ps4/linux_patches"
BR2_LINUX_KERNEL_USE_CUSTOM_CONFIG=y
BR2_LINUX_KERNEL_CUSTOM_CONFIG_FILE="$(BR2_EXTERNAL_RETROLX_PATH)/board/retrolx/ps4/linux-ps4_defconfig.config"
BR2_LINUX_KERNEL_NEEDS_HOST_LIBELF=y
BR2_LINUX_KERNEL_NEEDS_HOST_OPENSSL=y

# Required to build ??
BR2_PACKAGE_UTIL_LINUX_LIBSMARTCOLS=y
BR2_PACKAGE_UTIL_LINUX_SETTERM=y
BR2_PACKAGE_UTIL_LINUX_LIBMOUNT=y

# Build as zstd squashfs
BR2_PACKAGE_HOST_SQUASHFS=y

# Out-of-tree kernel modules
BR2_PACKAGE_RTL8192EU=y
#BR2_PACKAGE_RTL8821AU=y
#BR2_PACKAGE_RTL8189FS=y

# Disable ccache
BR2_CCACHE=y

# This config fragment disables Buildroot options that are turned on by
# default, in order to arrive at minimal build time.
BR2_INIT_NONE=y
BR2_SYSTEM_BIN_SH_NONE=y
# BR2_PACKAGE_BUSYBOX is not set
# BR2_TARGET_ROOTFS_TAR is not set
BR2_COMPILER_PARANOID_UNSAFE_PATH=y
BR2_PACKAGE_BUSYBOX_SHOW_OTHERS=y
# Package Patches
BR2_GLOBAL_PATCH_DIR="$(BR2_EXTERNAL_RETROLX_PATH)/board/retrolx/patches"
```
